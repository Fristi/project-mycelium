## firmware/sdkconfig.defaults
```kconfig
CONFIG_COMPILER_OPTIMIZATION_SIZE=y
CONFIG_RTC_CLK_SRC_INT_8MD256=y

# Bluetooth
CONFIG_BT_ENABLED=y
CONFIG_BT_BTC_TASK_STACK_SIZE=16384
CONFIG_BT_BLE_DYNAMIC_ENV_MEMORY=y
CONFIG_BT_BLE_42_FEATURES_SUPPORTED=y

# Stacks
CONFIG_ESP_IPC_TASK_STACK_SIZE=1024
CONFIG_ESP_MAIN_TASK_STACK_SIZE=49176
CONFIG_FREERTOS_IDLE_TASK_STACKSIZE=3200

# Logging
CONFIG_LOG_DEFAULT_LEVEL_INFO=y
CONFIG_LOG_TIMESTAMP_SOURCE_SYSTEM=y

# Bluetooth debugging options
CONFIG_BT_STACK_NO_LOG=y

# TLS
CONFIG_MBEDTLS_DEFAULT_MEM_ALLOC=y
CONFIG_MBEDTLS_EXTERNAL_MEM_ALLOC=y
CONFIG_MBEDTLS_DYNAMIC_BUFFER=y
CONFIG_MBEDTLS_DYNAMIC_FREE_PEER_CERT=y
CONFIG_MBEDTLS_DYNAMIC_FREE_CONFIG_DATA=y
```
